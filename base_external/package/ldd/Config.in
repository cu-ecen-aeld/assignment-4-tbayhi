## base_external/package/ldd/Config.in
```kconfig
config BR2_PACKAGE_LDD
	bool "ldd"
	help
	  Includes the scull module and additional modules in misc-utils.
	  Used to understand buildroot module generation and packaging.
```
